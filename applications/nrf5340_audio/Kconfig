## applications/nrf5340_audio/Kconfig
```kconfig
#
# Copyright (c) 2018 Nordic Semiconductor ASA
#
# SPDX-License-Identifier: LicenseRef-Nordic-5-Clause
#

menuconfig NRF5340_AUDIO
	 bool "nRF5340 Audio [EXPERIMENTAL]"
	 select EXPERIMENTAL

if NRF5340_AUDIO

config AUDIO_DEV
	int "Select which device type to compile for. 1=HEADSET or 2=GATEWAY"
	range 1 2
	default 1
	help
	  Setting this variable to 1 selects that the project is compiled
	  as a HEADSET device.
	  Setting to 2 will compile as a GATEWAY.

choice NRF5340_AUDIO_TRANSPORT_MODE
	prompt "Choose BIS or CIS for ISO transport"
	default TRANSPORT_CIS if WALKIE_TALKIE_DEMO
	default TRANSPORT_CIS

config TRANSPORT_BIS
	bool "Use BIS (Broadcast Isochronous Stream)"

config TRANSPORT_CIS
	bool "Use CIS (Connected Isochronous Stream)"

endchoice

#----------------------------------------------------------------------------#
if (TRANSPORT_BIS && AUDIO_DEV = 1)
rsource "broadcast_sink/Kconfig.defaults"
endif # TRANSPORT_BIS && AUDIO_DEV = 1

if (TRANSPORT_BIS && AUDIO_DEV = 2)
rsource "broadcast_source/Kconfig.defaults"
endif # TRANSPORT_BIS && AUDIO_DEV = 2

if (TRANSPORT_CIS && AUDIO_DEV = 1)
rsource "unicast_server/Kconfig.defaults"
endif # TRANSPORT_CIS && AUDIO_DEV = 1

if (TRANSPORT_CIS && AUDIO_DEV = 2)
rsource "unicast_client/Kconfig.defaults"
endif # TRANSPORT_CIS && AUDIO_DEV = 2



rsource "Kconfig.defaults"
rsource "src/audio/Kconfig"
rsource "src/bluetooth/Kconfig"
rsource "src/drivers/Kconfig"
rsource "src/modules/Kconfig"
rsource "src/utils/Kconfig"
rsource "dfu/conf/Kconfig.dfu"

#----------------------------------------------------------------------------#
menu "Logging"

module = MAIN
module-str = main
source "subsys/logging/Kconfig.template.log_config"

module = NRF5340_AUDIO_COMMON
module-str = nrf5340_audio_common
source "subsys/logging/Kconfig.template.log_config"

config PRINT_STACK_USAGE_MS
	depends on THREAD_ANALYZER && INIT_STACKS
	int "Print stack usage every x milliseconds"
	default 5000

endmenu # Log levels

#----------------------------------------------------------------------------#

#----------------------------------------------------------------------------#
menu "Loop Demo Modes"

config LOOP_VAR_DELAY_DEMO
	bool "Enables or disable variable delay demo mode"
	default y
	help
	  This option enables or disables the variable delay demo mode.
	  When enabled, buttons 4 and 5 are used to respectively increase or decrease the audio
	  delay of the received audio. The delay is changed in steps of 10 ms, between 40ms and 140ms.
endmenu # Loop Demo Modes

#----------------------------------------------------------------------------#
endif # NRF5340_AUDIO

source "Kconfig.zephyr"
```
